## src/Kconfig
```kconfig
source "src/core/Kconfig"
source "src/lib/Kconfig"
source "src/drivers/Kconfig"
source "src/modules/Kconfig"
source "src/middleware/Kconfig"
```

## src/middleware/uorb/Kconfig
```kconfig
config RTFRAME_UORB
    bool "Enable uORB message bus"
    default n
    help
      PX4-style publish/subscribe message bus.
```

## src/middleware/uorb/uORB/Kconfig
```kconfig
menuconfig ORB_COMMUNICATOR
	bool "orb communicator"
	default n
	depends on PLATFORM_QURT || PLATFORM_POSIX
	---help---
		Enable support for the uorb communicator for distributed platforms

config UORB_SUBSCRIBE_HANDLE_MAX
	int "Maximum number of concurrent orb_subscribe handles"
	default 64
	range 8 256
	---help---
		Maximum number of simultaneous fd-style subscriptions (orb_subscribe).
		Each slot uses sizeof(Subscription) bytes on the heap.
		Increase if you see orb_subscribe returning -1.
```

## src/middleware/zbus/Kconfig
```kconfig
config RTFRAME_ZBUS
    bool "Enable zbus message bus"
    default n
    select ZBUS
    help
      Zephyr native zbus publish/subscribe message bus.
```
